## boards/shields/charybdis/Kconfig.defconfig
```kconfig
if SHIELD_CHARYBDIS_DONGLE

config ZMK_KEYBOARD_NAME
	default "Charybdis"

config ZMK_SPLIT_ROLE_CENTRAL
	default y

config ZMK_SPLIT_BLE_CENTRAL_PERIPHERALS
	default 2

config BT_MAX_CONN
	default 7

config BT_MAX_PAIRED
	default 7

endif

if SHIELD_CHARYBDIS_LEFT

config ZMK_KEYBOARD_NAME
	default "Charybdis_Left"

endif

if SHIELD_CHARYBDIS_RIGHT

config ZMK_KEYBOARD_NAME
	default "Charybdis_Right"

endif

if SHIELD_CHARYBDIS_LEFT || SHIELD_CHARYBDIS_RIGHT

config ZMK_SPLIT_ROLE_CENTRAL
	default n

endif

if SHIELD_CHARYBDIS_DONGLE || SHIELD_CHARYBDIS_LEFT || SHIELD_CHARYBDIS_RIGHT

config ZMK_SPLIT
	default y

endif
```

## boards/shields/corne_lp/Kconfig.defconfig
```kconfig
if SHIELD_CORNE_LP_LEFT

config ZMK_KEYBOARD_NAME
	default "Corne"

config ZMK_SPLIT_ROLE_CENTRAL
	default y

endif

if SHIELD_CORNE_LP_RIGHT

config ZMK_KEYBOARD_NAME
	default "Corne_Right"

endif

if SHIELD_CORNE_LP_LEFT || SHIELD_CORNE_LP_RIGHT

config ZMK_SPLIT
	default y

endif
```

## boards/shields/corne_lp/Kconfig.shield
```kconfig
# Copyright (c) 2020 Pete Johanson
# SPDX-License-Identifier: MIT

config SHIELD_CORNE_LP_LEFT
	def_bool $(shields_list_contains,corne_lp_left)

config SHIELD_CORNE_LP_RIGHT
	def_bool $(shields_list_contains,corne_lp_right)
```

## boards/shields/corne_xiao/Kconfig.defconfig
```kconfig
if SHIELD_CORNE_XIAO_DONGLE

config ZMK_KEYBOARD_NAME
	default "Corne"

config ZMK_SPLIT_ROLE_CENTRAL
	default y

config ZMK_SPLIT_BLE_CENTRAL_PERIPHERALS
	default 2

config BT_MAX_CONN
    default 6

config BT_MAX_PAIRED
    default 6

endif

if SHIELD_CORNE_XIAO_LEFT

config ZMK_KEYBOARD_NAME
	default "Corne_Left"

endif

if SHIELD_CORNE_XIAO_RIGHT

config ZMK_KEYBOARD_NAME
	default "Corne_Right"

endif

if SHIELD_CORNE_XIAO_LEFT || SHIELD_CORNE_XIAO_RIGHT

config ZMK_SPLIT_ROLE_CENTRAL
	default n
 
endif

if SHIELD_CORNE_XIAO_DONGLE || SHIELD_CORNE_XIAO_LEFT || SHIELD_CORNE_XIAO_RIGHT

	config ZMK_SPLIT
		default y

endif
```

## boards/shields/corne_xiao/Kconfig.shield
```kconfig
# Copyright (c) 2020 Pete Johanson
# SPDX-License-Identifier: MIT

config SHIELD_CORNE_XIAO_LEFT
	def_bool $(shields_list_contains,corne_xiao_left)

config SHIELD_CORNE_XIAO_RIGHT
	def_bool $(shields_list_contains,corne_xiao_right)

config SHIELD_CORNE_XIAO_DONGLE
	def_bool $(shields_list_contains,corne_xiao_dongle)
```

## config/boards/shields/corne_xiao/Kconfig.shield
```kconfig
# Copyright (c) 2020 Pete Johanson
# SPDX-License-Identifier: MIT

config SHIELD_CORNE_XIAO_LEFT
	def_bool $(shields_list_contains,corne_xiao_left)

config SHIELD_CORNE_XIAO_RIGHT
	def_bool $(shields_list_contains,corne_xiao_right)
```
