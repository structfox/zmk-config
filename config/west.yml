## config/west.yml
```yaml
manifest:
  remotes:
    - name: zmkfirmware
      url-base: https://github.com/zmkfirmware
    - name: badjeff
      url-base: https://github.com/badjeff
    - name: englmaxi
      url-base: https://github.com/englmaxi
    - name: structfox
      url-base: https://github.com/structfox
  projects:
    - name: zmk
      remote: zmkfirmware
      revision: main
      import: app/west.yml
    - name: zmk-pmw3610-driver
      remote: badjeff
      revision: main
    - name: zmk-dongle-display
      remote: englmaxi
      revision: main
    # 배터리% 타이핑 behavior (&bat_print) — eintim 모듈을 동글(좌/우 peripheral)용으로 포크.
    - name: zmk-behavior-battery-typer
      remote: structfox
      revision: 31c0bf3
  self:
    path: config
```
